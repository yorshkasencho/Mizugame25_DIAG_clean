## config/boards/shields/mizugame25_diag/Kconfig.defconfig
```kconfig
if SHIELD_MIZUGAME25_DIAG

config ZMK_KEYBOARD_NAME
    default "Mizu25-DIAG"

endif
```

## config/boards/shields/mizugame25_diag/Kconfig.shield
```kconfig
config SHIELD_MIZUGAME25_DIAG
    def_bool $(shields_list_contains,mizugame25_diag)
```
